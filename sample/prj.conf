## CMakeLists.txt
```
cmake_minimum_required(VERSION 3.20.0)

find_package(Zephyr REQUIRED HINTS $ENV{ZEPHYR_BASE})

project(ping_sample)

zephyr_include_directories(include)

target_sources(app PRIVATE 
    src/main.c
    src/sidewalk_callbacks.c
    src/sidewalk_workitems.c
    src/queue.c
)
```

## Kconfig
```
config SID_WORK_Q_STACK_SIZE
	int "Sidewalk workqueue thread stack size"
	default 8192
	help
	  Sets size of stack of sidewalk workqueue thread.
	  Setting this value too low may cause stack overflow.

config SID_WORK_Q_PRIORITY
	int "Sidewalk workqueue thread priority"
	default 14
	help
	  Sets priority of sidewalk workqueue thread.

config LOG_QUEUE_SIZE
	int "Size of message queue"
	default 20
	help
		Sets size of maximum messages loig queue can hold at the same time

config MSG_SIZE
	int "Length of the message"
	default 256
	help
		Set maximum length of message log queue can hold

source "Kconfig.zephyr"
```

## prj.conf
```kconfig
#
# Copyright (c) 2022 Nordic Semiconductor ASA
#
# SPDX-License-Identifier: LicenseRef-Nordic-5-Clause
#

# Sidewalk
CONFIG_SIDEWALK=y

# Logs
CONFIG_SIDEWALK_LOG_LEVEL_INF=y
CONFIG_NVS_LOG_LEVEL_WRN=y
CONFIG_LOG_PRINTK=y
CONFIG_LOG=y

# Buttons and LEDs
CONFIG_GPIO=y
CONFIG_DK_LIBRARY=y

# Bluetooth
CONFIG_BT_DEVICE_NAME="Sid BLE template"

# Debug
CONFIG_RESET_ON_FATAL_ERROR=n

# Power Management
CONFIG_PM_DEVICE=y


CONFIG_MSG_SIZE=64
```

## src/main.c
```c
#include <main.h>
#include <pal_init.h>
#include <sidewalk_callbacks.h>
#include <sidewalk_workitems.h>
#include <zephyr/logging/log.h>

LOG_MODULE_REGISTER(main, LOG_LEVEL_DBG);

static app_ctx_t main_ctx;

int main(void) {
  main_ctx.is_init = false;
  if (application_pal_init()) {
    LOG_ERR("Failed to initialze PAL layer for sidewalk applicaiton.");
    return 0;
  }
  sid_error_t err;
  if ((err = sidewalk_callbacks_set(&main_ctx, &main_ctx.event_callbacks)) !=
      SID_ERROR_NONE) {
    LOG_ERR("SETTING CALLBACKS FAILED: %d", err);
    return 0;
  }
  sidewalk_workqueue_init(&main_ctx);
  return 0;
}
```

## include/main.h
```c
#ifndef SIDEWALK_COMMON_H
#define SIDEWALK_COMMON_H

#include <stdbool.h>

#include <zephyr/kernel.h>

#include <queue.h>
#include <sid_api.h>

typedef struct application_context {
  struct sid_event_callbacks event_callbacks;
  struct sid_config config;
  struct sid_handle* handle;
  queue message_queue;
  struct k_work sidewalk_event;
  struct k_work sidewalk_start;
  struct k_work sidewalk_conn_request;
  struct k_work sidewalk_send_message;
  struct k_work sidewalk_process_event;
  struct k_work_q sid_q;
  bool is_init;
} app_ctx_t;

#endif /* SIDEWALK_COMMON_H */
```

## include/queue.h
```c
#ifndef QUEUE_H
#define QUEUE_H

#include <sid_api.h>

typedef struct {
  struct sid_msg message;
  uint8_t msg_data[CONFIG_MSG_SIZE];
  sys_snode_t l_item;
} queue_item;

typedef struct {
  queue_item queue_buffer[CONFIG_LOG_QUEUE_SIZE];
  sys_slist_t queue_list;
  int size;
} queue;

void queue_init(queue* q);
int queue_push(const struct sid_msg* message, queue* q);
struct sid_msg* queue_front(queue* q);
int queue_pop(queue* q);

#endif /* QUEUE_H */
```

## include/sidewalk_callbacks.h
```c
#ifndef SIDEWALK_CALLBACKS_H
#define SIDEWALK_CALLBACKS_H

#include <sid_api.h>

sid_error_t sidewalk_callbacks_set(void* context,
                                   struct sid_event_callbacks* callbacks);

#endif /* SIDEWALK_CALLBACKS_H */
```

## include/sidewalk_common.h
```c
#ifndef SIDEWALK_COMMON_H
#define SIDEWALK_COMMON_H

#include <stdbool.h>

#include <zephyr/kernel.h>

#include <sid_api.h>
#include <queue.h>

typedef struct application_context {
	struct sid_event_callbacks event_callbacks;
	struct sid_config config;
	struct sid_handle *handle;
	queue message_queue;
	bool is_init;
} app_ctx_t; 

extern app_ctx_t app_ctx;

extern struct k_work_q sid_q;

#endif /* SIDEWALK_COMMON_H */
```

## include/sidewalk_workitems.h
```c
#ifndef SIDEWALK_WORKITEMS_H
#define SIDEWALK_WORKITEMS_H

#include <zephyr/kernel.h>

#include <main.h>

void sidewalk_workqueue_init(app_ctx_t* context);

#endif /* SIDEWALK_WORKITEMS_H */
```

## src/queue.c
```c
#include <zephyr/kernel.h>
#include <zephyr/logging/log.h>

#include <sid_api.h>

#include <queue.h>

LOG_MODULE_REGISTER(log_queue, LOG_LEVEL_DBG);

void queue_init(queue* q) {
  sys_slist_init(&q->queue_list);
  q->size = 0;
}

static queue_item* get_item(queue* q) {
  static int index = 0;
  index %= CONFIG_LOG_QUEUE_SIZE;
  return &q->queue_buffer[index++];
}

int queue_push(const struct sid_msg* message, queue* q) {
  if (q->size >= CONFIG_LOG_QUEUE_SIZE) { return 1; }
  queue_item* new_node = get_item(q);
  if (message->size > CONFIG_MSG_SIZE) {
    LOG_ERR("MESSAGE TOO LONG TO PLACE, SIZE: %d", message->size);
    return 1;
  }
  memcpy(new_node->msg_data, message->data, message->size);
  new_node->message.data = new_node->msg_data;
  new_node->message.size = message->size;
  sys_slist_append(&q->queue_list, &new_node->l_item);
  q->size++;
  return 0;
}

struct sid_msg* queue_front(queue* q) {
  if (q->size == 0) return NULL;
  queue_item* front_item =
      CONTAINER_OF(sys_slist_peek_head(&q->queue_list), queue_item, l_item);
  return &front_item->message;
}

int queue_pop(queue* q) {
  if (q->size <= 0) return 1;
  sys_slist_get(&q->queue_list);
  q->size--;
  return 0;
}
```

## src/sidewalk_callbacks.c
```c
#include <zephyr/kernel.h>
#include <zephyr/logging/log.h>

#include <sid_api.h>

#include <main.h>
#include <queue.h>
#include <sidewalk_workitems.h>

LOG_MODULE_REGISTER(sid_callbacks, LOG_LEVEL_DBG);

static void on_sidewalk_event(bool in_isr, void* context) {
  app_ctx_t* app_ctx = (app_ctx_t*)context;
  k_work_submit_to_queue(&app_ctx->sid_q, &app_ctx->sidewalk_event);
}

static void on_sidewalk_msg_received(const struct sid_msg_desc* msg_desc,
                                     const struct sid_msg* msg, void* context) {
  app_ctx_t* app_ctx = (app_ctx_t*)context;
  LOG_DBG("received message(type: %d, link_mode: %d, id: %u size %u)",
          (int)msg_desc->type, (int)msg_desc->link_mode, msg_desc->id,
          msg->size);
  LOG_HEXDUMP_INF((uint8_t*)msg->data, msg->size, "Message data: ");
  queue_push(msg, &app_ctx->message_queue);

  k_work_submit_to_queue(&app_ctx->sid_q, &app_ctx->sidewalk_process_event);
}

static void on_sidewalk_msg_sent(const struct sid_msg_desc* msg_desc,
                                 void* context) {
  LOG_DBG("on message sent");
}

static void on_sidewalk_send_error(sid_error_t error,
                                   const struct sid_msg_desc* msg_desc,
                                   void* context) {
  app_ctx_t* app_ctx = (app_ctx_t*)context;
  LOG_DBG("on send error");
  k_work_submit_to_queue(&app_ctx->sid_q, &app_ctx->sidewalk_process_event);
}

static void on_sidewalk_status_changed(const struct sid_status* status,
                                       void* context) {
  app_ctx_t* app_ctx = (app_ctx_t*)context;
  LOG_DBG("on status changed: %d", status->state);
  if (status->state == 0 && !app_ctx->is_init) {
    app_ctx->is_init = true;
    sid_ble_bcn_connection_request(app_ctx->handle, false);
    return;
  }
  if (!app_ctx->is_init) { return; }
  k_work_submit_to_queue(&app_ctx->sid_q, &app_ctx->sidewalk_process_event);
}

static void on_sidewalk_factory_reset(void* context) {
  LOG_DBG("on factory reset");
}

sid_error_t sidewalk_callbacks_set(void* context,
                                   struct sid_event_callbacks* callbacks) {
  if (!callbacks) { return SID_ERROR_INVALID_ARGS; }
  callbacks->context = context;
  callbacks->on_event = on_sidewalk_event;
  callbacks->on_msg_received =
      on_sidewalk_msg_received;                  /* Called from sid_process() */
  callbacks->on_msg_sent = on_sidewalk_msg_sent; /* Called from sid_process() */
  callbacks->on_send_error =
      on_sidewalk_send_error; /* Called from sid_process() */
  callbacks->on_status_changed =
      on_sidewalk_status_changed; /* Called from sid_process() */
  callbacks->on_factory_reset =
      on_sidewalk_factory_reset; /* Called from sid_process() */

  return SID_ERROR_NONE;
}
```

## src/sidewalk_globals.c
```c
#include <sidewalk_common.h>
#include <sidewalk_callbacks.h>
#include <sidewalk_workitems.h>

app_ctx_t app_ctx;

struct k_work_q sid_q;
```

## src/sidewalk_workitems.c
```c
#include <zephyr/kernel.h>
#include <zephyr/logging/log.h>

#include <app_ble_config.h>
#include <app_subGHz_config.h>
#include <sidewalk_version.h>

#include <main.h>
#include <queue.h>
#include <sidewalk_callbacks.h>
#include <sidewalk_workitems.h>

#define CREATE_WORKITEM(NAME, ...)                                             \
  static void NAME##_handler(struct k_work* work) __VA_ARGS__ K_WORK_DEFINE(   \
      NAME, NAME##_handler)

#define PRINT_MACRO(X) #X

LOG_MODULE_REGISTER(work, LOG_LEVEL_DBG);

CREATE_WORKITEM(sidewalk_event, {
  app_ctx_t* app_ctx = CONTAINER_OF(work, app_ctx_t, sidewalk_event);

  sid_process(app_ctx->handle);
});

CREATE_WORKITEM(sidewalk_process_event, {
  app_ctx_t* app_ctx = CONTAINER_OF(work, app_ctx_t, sidewalk_process_event);

  struct sid_status status = {.state = SID_STATE_NOT_READY};
  sid_error_t err = sid_get_status(app_ctx->handle, &status);

  if (app_ctx->message_queue.size == 0) return;

  switch (err) {
  case SID_ERROR_NONE:
    break;
  case SID_ERROR_INVALID_ARGS:
    LOG_ERR("Sidewalk library is not initialzied!");
    return;
  default:
    LOG_ERR("Unknown error during sid_get_status() -> %d", err);
    return;
  }

  if (status.state != SID_STATE_READY &&
      status.state != SID_STATE_SECURE_CHANNEL_READY) {
    k_work_submit_to_queue(&app_ctx->sid_q, &app_ctx->sidewalk_conn_request);
    return;
  }
  k_work_submit_to_queue(&app_ctx->sid_q, &app_ctx->sidewalk_send_message);
});

CREATE_WORKITEM(sidewalk_send_message, {
  app_ctx_t* app_ctx = CONTAINER_OF(work, app_ctx_t, sidewalk_send_message);

  static struct sid_msg_desc desc;

  struct sid_msg* msg = queue_front(&app_ctx->message_queue);

  if (msg == NULL) return;

  desc = (struct sid_msg_desc){
      .type = SID_MSG_TYPE_NOTIFY,
      .link_type = SID_LINK_TYPE_ANY,
      .link_mode = SID_LINK_MODE_CLOUD,
  };

  sid_error_t err = sid_put_msg(app_ctx->handle, msg, &desc);
  switch (err) {
  case SID_ERROR_NONE: {
    LOG_INF("queued data message id:%d", desc.id);
    break;
  }
  case SID_ERROR_TRY_AGAIN: {
    LOG_ERR("there is no space in the transmit queue, Try again.");
    k_work_submit_to_queue(&app_ctx->sid_q, &app_ctx->sidewalk_send_message);
    return;
  }
  default:
    LOG_ERR("Unknown error returned from sid_put_msg() -> %d", err);
    k_work_submit_to_queue(&app_ctx->sid_q, &app_ctx->sidewalk_send_message);
    return;
  }

  queue_pop(&app_ctx->message_queue);
  k_work_submit_to_queue(&app_ctx->sid_q, &app_ctx->sidewalk_send_message);
});

CREATE_WORKITEM(sidewalk_conn_request, {
  app_ctx_t* app_ctx = CONTAINER_OF(work, app_ctx_t, sidewalk_conn_request);

  struct sid_status status = {.state = SID_STATE_NOT_READY};
  sid_error_t err = sid_get_status(app_ctx->handle, &status);

  switch (err) {
  case SID_ERROR_NONE:
    break;
  case SID_ERROR_INVALID_ARGS:
    LOG_ERR("ERROR_VALUE = %d; LINE: %d", err, __LINE__);
    return;
  default:
    LOG_ERR("ERROR_VALUE = %d; LINE: %d", err, __LINE__);
    return;
  }

  if (status.state != SID_STATE_READY &&
      status.state != SID_STATE_SECURE_CHANNEL_READY) {
    err = sid_ble_bcn_connection_request(app_ctx->handle, true);
  }

  if (err != SID_ERROR_NONE) {
    LOG_ERR("ERROR_VALUE = %d; LINE: %d", err, __LINE__);
  }
});

CREATE_WORKITEM(sidewalk_start, {
  app_ctx_t* app_ctx = CONTAINER_OF(work, app_ctx_t, sidewalk_start);
  PRINT_SIDEWALK_VERSION();
  app_ctx->config = (struct sid_config){
      .link_mask = SID_LINK_TYPE_1,
      .time_sync_periodicity_seconds = 7200,
      .callbacks = &app_ctx->event_callbacks,
      .link_config = app_get_ble_config(),
      .sub_ghz_link_config = NULL,
  };
  queue_init(&app_ctx->message_queue);
  struct sid_msg msg = (struct sid_msg){
      .data = "Hello World!",
      .size = 12,
  };
  queue_push(&msg, &app_ctx->message_queue);

  sid_error_t err;

  if ((err = sid_init(&app_ctx->config, &app_ctx->handle)) != SID_ERROR_NONE) {
    LOG_ERR("INITIALIZATION FAILED: %d", err);
    return;
  }
  if ((err = sid_start(app_ctx->handle, SID_LINK_TYPE_1)) != SID_ERROR_NONE) {
    LOG_ERR("STARTING FAILED: %d", err);
    return;
  }
  LOG_INF("SIDEWALK STARTED %d", err);
});

K_THREAD_STACK_DEFINE(sid_work_q_stack, CONFIG_SID_WORK_Q_STACK_SIZE);

void sidewalk_workqueue_init(app_ctx_t* context) {
  context->sidewalk_event = sidewalk_event;
  context->sidewalk_start = sidewalk_start;
  context->sidewalk_conn_request = sidewalk_conn_request;
  context->sidewalk_send_message = sidewalk_send_message;
  context->sidewalk_process_event = sidewalk_process_event;
  k_work_queue_init(&context->sid_q);
  k_work_queue_start(&context->sid_q, sid_work_q_stack,
                     K_THREAD_STACK_SIZEOF(sid_work_q_stack),
                     CONFIG_SID_WORK_Q_PRIORITY, NULL);
  k_work_submit_to_queue(&context->sid_q, &context->sidewalk_start);
}
```
